## config/Kconfig.defconfig
```kconfig
#
# Copyright (c) 2024 The ZMK Contributors
# SPDX-License-Identifier: MIT
#

if SHIELD_EKGO_LEFT

config ZMK_KEYBOARD_NAME
    default "Corne"

config ZMK_SPLIT_ROLE_CENTRAL
    default y

endif 

if SHIELD_EKGO_LEFT || SHIELD_EKGO_RIGHT

# config BOARD_ENABLE_DCDC
#     bool "Enable DCDC mode"
#     select SOC_DCDC_NRF52X
#     default y

# config BOARD_ENABLE_DCDC_HV
#     bool "Enable High Voltage DCDC converter"
#     default y
#     select SOC_DCDC_NRF52X_HV
#     depends on (SHIELD_EKGO_LEFT || SHIELD_EKGO_RIGHT) 

config ZMK_SLEEP
    default y

config ZMK_SPLIT
    default y

config BT_CTLR
    default BT

if USB

config USB_NRFX
    default y

config USB_DEVICE_STACK
    default y

endif # USB

if ZMK_BACKLIGHT

config PWM
    default y

config LED_PWM
    default y

endif # ZMK_BACKLIGHT

endif # SHIELD_ERGOKEEB_CORNE_LEFT || SHIELD_ERGOKEEB_CORNE_RIGHT
```

## config/Kconfig.shield
```kconfig
#
# Copyright (c) 2024 The ZMK Contributors
# SPDX-License-Identifier: MIT
#

config SHIELD_EKGO_LEFT
    def_bool $(shields_list_contains,ergokeeb_corne_left)

config SHIELD_EKGO_RIGHT
    def_bool $(shields_list_contains,ergokeeb_corne_right)
```
